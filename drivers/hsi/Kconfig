## drivers/hsi/Kconfig
```kconfig
#
# HSI driver configuration
#
menuconfig HSI
	tristate "HSI support"
	---help---
	  The "High speed synchronous Serial Interface" is
	  synchronous serial interface used mainly to connect
	  application engines and cellular modems.

if HSI

config HSI_BOARDINFO
	bool
	default y

config HSI_NO_MODEM
	bool "HSI no modem support"
	default n
	help
	  modem switch off

config MARVELL_MODEM
	bool "marvell 1802 modem support"
	default n
	help
	  marvell 1802 modem support

config MARVELL_MODEM_HSI
	bool "marvell modem hsi port support"
	default n
	help
	  marvell 1802 modem hsi port support
source "drivers/hsi/controllers/Kconfig"
source "drivers/hsi/clients/Kconfig"

endif # HSI
```
